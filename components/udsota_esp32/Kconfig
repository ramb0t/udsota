## components/udsota_esp32/Kconfig
```kconfig
menu "udsota ESP32 port"

    config UDSOTA_ESP32_WORKER_CORE
        int "Flash worker core"
        range 0 0 if FREERTOS_UNICORE
        range 0 1
        default 0

    config UDSOTA_ESP32_WORKER_PRIO
        int "Flash worker priority"
        range 1 24
        default 3
        help
            The worker runs every erase and write, busy-waiting through an erase of up to about 43 s.
            Keep it below the app's own tasks (a UI, say) so they keep running.

    config UDSOTA_ESP32_WORKER_STACK
        int "Flash worker stack (bytes)"
        range 4096 32768
        default 8192
        help
            Always internal RAM, since the worker writes flash. 8192 fits the RSA-3072 signature check
            inside esp_ota_end().

    config UDSOTA_ESP32_COMPRESSION
        bool "Compressed downloads (RequestDownload DFI 0x10, raw DEFLATE)"
        default n
        help
            Serve downloads whose 0x36 blocks carry a raw DEFLATE stream of the image. The flash worker
            inflates each block (tinfl: the ROM's copy, which every target has) before it writes, so
            an update crosses the bus in roughly 60 % of the time. Each such download allocates about 47 KB
            at its 34 (the inflater's 11 KB state and 32 KB dictionary, and a 4 KB internal buffer) and frees
            it at its 37 or abort; nothing at boot. A 34 that finds no memory is refused with 0x22.
            Compressed downloads cannot resume. Off, a 34 with DFI 0x10 answers 0x31 as before.

    config UDSOTA_ESP32_DELTA
        bool "Delta downloads (RequestDownload DFI 0x20 and 0x30, a patch from the running image)"
        depends on UDSOTA_ESP32_COMPRESSION
        default n
        help
            Also serve downloads whose 0x36 blocks carry a patch from the image this device runs: DFI 0x20
            takes Espressif's esp_delta_ota format (a detools patch, heatshrink-compressed), and 0x30 the
            same format with an uncompressed patch, all of it raw DEFLATE, which is usually smaller. The
            flash worker rebuilds the new image from the running partition, which it only reads, into the
            other slot, and the rebuilt image gets the same first-block check before any erase and the same
            FF01 verify as a full one. A patch made from any other image is refused before any erase with
            reason 15, and the client falls back to a full download. A patch names its base by the
            SHA-256 the running image stores, which FF01 backs up: a base that differs from it only
            rebuilds an image FF01 refuses. Each 0x20 download
            allocates about 5 KB of internal RAM at its 34 (the 4 KB image buffer and the decoder's
            state), and a 0x30 one also the inflater and a 1 KB buffer; all of it is freed at the 37 or
            abort. Delta downloads cannot resume. Off, no detools code is linked and a 34 with DFI 0x20
            or 0x30 answers 0x31.

    config UDSOTA_ESP32_INFLATE_PSRAM
        bool "Inflater state and dictionary in PSRAM"
        depends on UDSOTA_ESP32_COMPRESSION && SPIRAM && !(IDF_TARGET_ESP32 && ESP32_REV_MIN_FULL < 300)
        default y
        help
            Allocate the inflater's 43 KB in PSRAM, falling back to internal RAM, so only the 4 KB
            buffer the worker writes flash from comes from internal RAM, and for a delta download (DFI
            0x30) also its 1 KB patch buffer and the patch decoder's state, under 1 KB. Off, all of it
            is internal.
            Not offered for an ESP32 below revision 3: its PSRAM cache bug can lose a write when an
            interrupt lands, and the ROM's tinfl, which writes the dictionary, is not built with
            the compiler's workaround (ESP-IDF keeps ROM newlib off PSRAM there for the same reason).

    config UDSOTA_ESP32_DEBUG_MEASURE
        bool "Log update timings, stack headroom, internal heap and cache-off writes"
        default n
        help
            Bench measurement only. Logs at INFO: the erase time (esp_ota_begin), the FF01 verify and
            ActivateImage times with the worker's unused stack and the internal heap around them, the
            diag task's stack headroom and internal-heap low-water mark, the heap the start took, and a
            warning when flash writes run with the cache off, which on a build running code from flash is
            every download.

endmenu
```

## examples/esp32/main/Kconfig.projbuild
```kconfig
menu "udsota example"

    config EXAMPLE_CAN_TX_GPIO
        int "TWAI TX GPIO"
        default 4
        help
            GPIO wired to the CAN transceiver's TXD input.

    config EXAMPLE_CAN_RX_GPIO
        int "TWAI RX GPIO"
        default 5
        help
            GPIO wired to the CAN transceiver's RXD output.

    config EXAMPLE_CAN_BITRATE
        int "CAN bit rate (bit/s)"
        default 500000
        help
            The bus's bit rate; udsota needs no particular one.

endmenu
```
